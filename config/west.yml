## config/west.yml
```yaml
manifest:
  defaults:
    revision: v0.3
  remotes:
    - name: zmkfirmware
      url-base: https://github.com/zmkfirmware
      # Additional modules containing boards/shields/custom code can be listed here as well
      # See https://docs.zephyrproject.org/3.2.0/develop/west/manifest.html#projects
    - name: m165437 #custom view
      url-base: https://github.com/M165437 #custom view
    # support nice_oled and nice_epaper
    - name: mctechnology17
      url-base: https://github.com/mctechnology17
  projects:
    - name: zmk
      remote: zmkfirmware
      import: app/west.yml
    - name: nice-view-gem
      remote: m165437
      revision: v0.3.0
  self:
    path: config
```
